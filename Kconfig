## Kconfig
```kconfig
menu "DSP-Crowd Electronics GmbH"

config PROC_HAVE_LOG
	bool "Enable process log system"
	default "n"
	help
		Log file available for target

config PROC_SHOW_ADDRESS_IN_ID
	bool "Show address in process ID"
	default "n"
	help
		Show address in process ID

config PROC_HAVE_LIB_STD_CPP
	bool "System has libstdc++"
	default "y"
	help
		System has libstdc++

config PROC_INFO_BUFFER_SIZE
	int "Process info buffer size"
	default "1021"
	help
		Number of bytes for process info buffer

config CMD_SIZE_BUFFER_OUT
	int "Command output buffer size"
	default "2017"
	help
		Maximum size for command output messages

endmenu
```
